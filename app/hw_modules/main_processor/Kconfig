## sample.yaml
```yaml
sample:
  description: Zephyr application sample showcasing some structuring approaches for different kinds of file types used directly or along with Zephyr platform. 
    application
  name: zephyr application structuring template
common:
    tags: introduction
```
